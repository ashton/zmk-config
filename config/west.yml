## config/west.yml
```yaml
manifest:
  defaults:
    revision: v0.3
  remotes:
    - name: zmkfirmware
      url-base: https://github.com/zmkfirmware
    - name: urob
      url-base: https://github.com/urob
    - name: beekeeb
      url-base: https://github.com/beekeeb
    - name: caksoylar
      url-base: https://github.com/caksoylar
    # Additional modules containing boards/shields/custom code can be listed here as well
    # See https://docs.zephyrproject.org/3.2.0/develop/west/manifest.html#projects
  projects:
    - name: zmk
      remote: zmkfirmware
      import: app/west.yml
    - name: zmk-keyboard-toucan2
      remote: beekeeb
      revision: main
      path: modules/zmk-keyboard-toucan2
    - name: zmk-helpers
      remote: urob
      revision: v0.3
    - name: zmk-auto-layer
      remote: urob
      revision: v0.3
    - name: zmk-tri-state
      remote: urob
      revision: v0.3
    - name: zmk_driver_azoteq
      remote: beekeeb
      revision: main
    - name: zmk-input-zoom
      remote: beekeeb
      revision: main
    - name: zmk-rgbled-widget
      remote: caksoylar
      revision: v0.3
  self:
    path: config
```
