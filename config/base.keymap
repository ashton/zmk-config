#include <behaviors.dtsi>
#include <zmk-helpers/helper.h> // Requires zmk-helpers module.
#include <dt-bindings/zmk/keys.h>
#include <behaviors/num_word.dtsi>

#ifdef CONFIG_WIRELESS
  #include <dt-bindings/zmk/bt.h>
  #define _BT_KEYS_                                                        \
      &bt BT_CLR &bt BT_SEL 0 &bt BT_SEL 1 &bt BT_SEL 2 &bt BT_SEL 3 &bt BT_SEL 4
#else
  #define _BT_KEYS_ &trans &trans &trans &trans &trans &trans
#endif

#define DEF 0
#define SYM 1
#define NAV 2
#define NUM 3

#define XXX &none
#define ___ &trans

#define QUICK_TAP_MS 175

&lt {
  flavor = "balanced";
  tapping-term-ms = <200>;
  quick-tap-ms = <QUICK_TAP_MS>;
};

// Trigger tap-action on all interrupts.
#define MT_CORE                                                                \
  flavor = "tap-preferred";                                                    \
  tapping-term-ms = <220>;                                                     \
  quick-tap-ms = <220>;                                                        \
  hold-trigger-key-positions = <0>;

&mt { MT_CORE };

#define KEYS_L LT5 LT4 LT3 LT2 LT1 LT0 LM5 LM4 LM3 LM2 LM1 LM0 LB5 LB4 LB3 LB2 LB1 LB0
#define KEYS_R RT0 RT1 RT2 RT3 RT4 RT5 RM0 RM1 RM2 RM3 RM4 RM5 RB0 RB1 RB2 RB3 RB4 RB5
#define THUMBS LH2 LH1 LH0 RH0 RH1 RH2

#define MAKE_HRM(NAME, HOLD, TAP, TRIGGER_POS)                                 \
  ZMK_HOLD_TAP(NAME, bindings = <HOLD>, <TAP>; flavor = "balanced";            \
               tapping-term-ms = <280>; quick-tap-ms = <QUICK_TAP_MS>;         \
               require-prior-idle-ms = <150>; hold-trigger-on-release;         \
               hold-trigger-key-positions = <TRIGGER_POS>;)

MAKE_HRM(hml, &kp, &kp, KEYS_R THUMBS) // Left-hand HRMs.
MAKE_HRM(hmr, &kp, &kp, KEYS_L THUMBS) // Right-hand HRMs.

&caps_word { // Mods deactivate caps-word
  /delete-property/ ignore-modifiers;
};


// Tap: num-word | double-tap: sticky num-layer | Hold: num-layer.
#define SMART_NUM &smart_num NUM 0

ZMK_HOLD_TAP(smart_num, bindings = <&mo>, <&num_dance>; flavor = "balanced";
             tapping-term-ms = <200>; quick-tap-ms = <QUICK_TAP_MS>;)
ZMK_TAP_DANCE(num_dance, bindings = <&num_word NUM>, <&sl NUM>;
              tapping-term-ms = <200>;)

// Alt+Tab swapper, requires tri-state module.
ZMK_TRI_STATE(swapper, bindings = <&kt LALT>, <&kp TAB>, <&kt LALT>;
              ignored-key-positions = <LT2 RT2 RM1 RM2 RM3>;)

// Tap: backspace | Lshft + tap: delete | Rshft + tap: shift-delete.
ZMK_MOD_MORPH(bs_del, bindings = <&kp BSPC>, <&kp DEL>;
              mods = <(MOD_LSFT|MOD_RSFT)>; keep-mods = <MOD_RSFT>;)

// Tap: [ | shift + tap: {
ZMK_MOD_MORPH(open_bracket, bindings = <&kp LBKT>, <&kp LBKT>;
              mods = <(MOD_LSFT|MOD_RSFT)>;)

// Tap: ] | shift + tap: }
ZMK_MOD_MORPH(close_bracket, bindings = <&kp RBKT>, <&kp RBKT>;
              mods = <(MOD_LSFT|MOD_RSFT)>;)

// Misc aliases.
#define CANCEL    &kp K_CANCEL            // Cancel caps-word & auto-layers.
#define SPC_LSFT  &mt LSHFT SPACE
#define SPC_RSFT  &mt RSHFT SPACE

#ifndef ZMK_BASE_LAYER
  #define ZMK_BASE_LAYER(name, LT, RT, LM, RM, LB, RB, LH, RH) \
      ZMK_LAYER(name, LT RT LM RM LB RB LH RH)
#endif

ZMK_BASE_LAYER(Base,
//╭─────────────┬─────────────┬─────────────┬───────────────┬─────────────┬─────────────╮ ╭─────────────┬─────────────┬─────────────┬─────────────┬─────────────┬─────────────╮
    &kp TAB       &kp Q         &kp W         &kp E           &kp R         &kp T       ,   &kp Y         &kp U         &kp I         &kp O         &kp P         &bs_del     ,
//├─────────────┼─────────────┼─────────────┼───────────────┼─────────────┼─────────────┤ ├─────────────┼─────────────┬─────────────┼─────────────┼─────────────┼─────────────┤
    &gresc        &hml LCTRL A  &hml LALT S   &hml LSHFT D    &hml LGUI F   &kp G       ,   &kp H         &hmr RGUI J   &hmr RSHFT K  &hmr LALT L &hmr RCTRL SEMI &kp ENTER   ,
//├─────────────┼─────────────┴─────────────┼───────────────┼─────────────┼─────────────┤ ├─────────────┼─────────────┼─────────────┬─────────────┼─────────────┼─────────────╯
   &open_bracket  &kp Z         &kp X         &kp C           &kp V         &kp B       ,   &kp N         &kp M         &kp COMMA     &kp DOT       &kp SLASH   &close_bracket,
//╰─────────────┴─────────────┴─────────────┼───────────────┼─────────────┼─────────────╯ ╰─────────────┼─────────────┼─────────────┴─────────────┴─────────────┴─────────────╯
                                                 SPC_LSFT    &lt SYM MINUS,                               &lt NAV SQT    SPC_RSFT              
//                            ╰─────────────┴───────────────┴─────────────╯                             ╰─────────────┴─────────────┴─────────────╯
)

ZMK_BASE_LAYER(Symbols,
//╭─────────────┬─────────────┬─────────────┬─────────────┬─────────────┬─────────────╮ ╭─────────────┬─────────────┬─────────────┬─────────────┬─────────────┬─────────────╮
    &swapper      &kp LS(N1)    &kp LS(N2)    &kp LS(N3)    &kp LS(N4)    &kp LS(N5)  ,   &kp LS(N6)    &kp LS(N7)    &kp LS(N8)    &kp LS(N9)    &kp LS(N0)    &kp EQUAL   ,
//├─────────────┼─────────────┼─────────────┼─────────────┼─────────────┼─────────────┤ ├─────────────┼─────────────┬─────────────┼─────────────┼─────────────┼─────────────┤
    &kp GRAVE         ___           ___           ___           ___       &caps_word  ,   &kp GRAVE     &kp LS(LBKT)  &kp LS(RBKT)     ___           ___        &kp PLUS    ,
//├─────────────┼─────────────┴─────────────┼─────────────┼─────────────┼─────────────┤ ├─────────────┼─────────────┼─────────────┬─────────────┼─────────────┼─────────────╯
       ___            ___           ___       &kp LT        &kp GT        &kp EQUAL   ,  &kp LS(EQUAL)  &kp LBKT      &kp RBKT      &kp LS(BSLH)  &kp BSLH          ___     ,
//╰─────────────┴─────────────┴─────────────┼─────────────┼─────────────┼─────────────╯ ╰─────────────┼─────────────┼─────────────┴─────────────┴─────────────┴─────────────╯
                                    ___           ___           XXX     ,                               &mo NUM           ___           ___      
//                            ╰─────────────┴─────────────┴─────────────╯                             ╰─────────────┴─────────────┴─────────────╯
)

ZMK_BASE_LAYER(Shortcuts,
//╭─────────────┬─────────────┬─────────────┬─────────────┬─────────────┬─────────────╮ ╭─────────────┬─────────────┬─────────────┬─────────────┬─────────────┬─────────────╮
    &swapper      &kp N1        &kp N2        &kp N3        &kp N4        &kp N5      ,   &kp N6        &kp N7        &kp N8        &kp N9        &kp N0        &kp EQUAL   ,
//├─────────────┼─────────────┼─────────────┼─────────────┼─────────────┼─────────────┤ ├─────────────┼─────────────┬─────────────┼─────────────┼─────────────┼─────────────┤
   &kp LC(LG(Q))      ___           ___       &kp LC(P)     &kp LC(N)     &kp K_COPY  ,   &kp LEFT     &kp DOWN       &kp UP        &kp RIGHT         ___           ___     ,
//├─────────────┼─────────────┴─────────────┼─────────────┼─────────────┼─────────────┤ ├─────────────┼─────────────┼─────────────┬─────────────┼─────────────┼─────────────╯
   &studio_unlock     ___           ___       &kp LC(LEFT) &kp LC(RIGHT)  &kp K_PASTE ,  &kp LS(EQUAL)  &kp LBKT      &kp RBKT      &kp LS(BSLH)  &kp BSLH          ___     ,
//╰─────────────┴─────────────┴─────────────┼─────────────┼─────────────┼─────────────╯ ╰─────────────┼─────────────┼─────────────┴─────────────┴─────────────┴─────────────╯
                                &kp F12      &kp LG(SPACE)  &mo NUM     ,                                   XXX           ___       &kp LS(LC(LG(N4))) 
//                            ╰─────────────┴─────────────┴─────────────╯                             ╰─────────────┴─────────────┴───────────────────╯
)

ZMK_BASE_LAYER(Numpad_BT,
//╭─────────────┬─────────────┬─────────────┬─────────────┬─────────────┬─────────────╮ ╭─────────────┬─────────────┬─────────────┬─────────────┬─────────────┬─────────────╮
                                         _BT_KEYS_                                    , &kp KP_MULTIPLY &kp KP_N7     &kp KP_N8     &kp KP_N9     &kp KP_MINUS      ___     ,
//├─────────────┼─────────────┼─────────────┼─────────────┼─────────────┼─────────────┤ ├─────────────┼─────────────┬─────────────┼─────────────┼─────────────┼─────────────┤
       ___            ___           ___           ___           ___       &sys_reset  ,  &kp KP_DIVIDE  &kp KP_N4     &kp KP_N5     &kp KP_N6     &kp KP_PLUS   &kp KP_EQUAL,
//├─────────────┼─────────────┴─────────────┼─────────────┼─────────────┼─────────────┤ ├─────────────┼─────────────┼─────────────┬─────────────┼─────────────┼─────────────╯
       ___            ___           ___           ___           ___       &bootloader ,   &kp KP_DOT    &kp KP_N1     &kp KP_N2     &kp KP_N3     &kp KP_COMMA      ___     ,
//╰─────────────┴─────────────┴─────────────┼─────────────┼─────────────┼─────────────╯ ╰─────────────┼─────────────┼─────────────┴─────────────┴─────────────┴─────────────╯
                                    ___           ___           XXX     ,                                   XXX       &kp KP_N0         ___      
//                            ╰─────────────┴─────────────┴─────────────╯                             ╰─────────────┴─────────────┴─────────────╯
)
